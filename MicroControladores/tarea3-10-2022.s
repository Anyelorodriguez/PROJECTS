
;puerto f
;GPIO_PORTF_DATA_R  	EQU 	0x400253FC
;GPIO_PORTF_DIR_R   	EQU 	0x40025400
;GPIO_PORTF_AFSEL_R 	EQU 	0x40025420
;GPIO_PORTF_PUR_R   	EQU 	0x40025510
;GPIO_PORTF_DEN_R   	EQU 	0x4002551C
;GPIO_PORTF_LOCK_R  	EQU 	0x40025520
;GPIO_PORTF_CR_R    	EQU 	0x40025524
;GPIO_PORTF_AMSEL_R 	EQU 	0x40025528
;GPIO_PORTF_PCTL_R  	EQU 	0x4002552C
;	
;puerto E
;GPIO_PORTE_DATA_R  	EQU 	0x400243FC
;GPIO_PORTE_DIR_R   	EQU 	0x40024400
;GPIO_PORTE_AFSEL_R 	EQU 	0x40024420
;GPIO_PORTE_DEN_R   	EQU 	0x4002451C
;GPIO_PORTB_LOCK_R  	EQU 	0x40005520 DEPRONTO ESTA DESBLOQUEADO YA EL PUERTO
;GPIO_PORTE_CR_R    	EQU 	0x40024524
;GPIO_PORTE_AMSEL_R 	EQU 	0x40024528
;GPIO_PORTE_PCTL_R  	EQU 	0x4002452C
;GPIO_PORTE_PUR_R   	EQU 	0x40024510


;puerto b
;GPIO_PORTB_DATA_R  	EQU 	0x400053FC
;GPIO_PORTB_DIR_R   	EQU 	0x40005400
;GPIO_PORTB_AFSEL_R 	EQU 	0x40005420
;GPIO_PORTB_DEN_R   	EQU 	0x4000551C
;GPIO_PORTB_LOCK_R  	EQU 	0x40005520 DEPRONTO ESTA DESBLOQUEADO YA EL PUERTO
;GPIO_PORTB_CR_R    	EQU 	0x40005524
;GPIO_PORTB_AMSEL_R 	EQU 	0x40005528
;GPIO_PORTB_PCTL_R  	EQU 	0x4000552C


;proposito general
;GPIO_LOCK_KEY      	EQU 	0x4C4F434B 
;SYSCTL_RCGC2_R  	EQU   	0x400FE108



			AREA    |.text|, CODE, READONLY, ALIGN=2
			THUMB
			GET		tm4c123gh6pm.s
			EXPORT  __main
			
		
			;SYSCTL_RCGC2_R = SYSCTL_RCGC2_R or 0x20	
			
__main		LDR		R0, =SYSCTL_RCGC2_R		; 	*R0 = SYSCTL_RCGC2_R
			LDR		R1, [R0]				; 	R1 = *R0
			MOV		R2, #0x32				; 	R2 = 0x02 HABILITA EL RELOJ EN LOS PUERTOS B , F Y E	
			ORR		R1, R1, R2				;	R1 = R1 (or) R2		
			STR		R1, [R0]				;	*R0 = R1
			NOP								; 	DELAY 1 CICLO
			NOP								; 	DELAY 1 CICLO
			NOP								; 	DELAY 1 CICLO
		
			;GPIO_PORTF_LOCK_R = GPIO_LOCK_KEY  &  GPIO_PORTB_LOCK_R = GPIO_LOCK_KEY
			
			LDR		R0, =GPIO_PORTF_LOCK_R
			LDR		R1, =GPIO_LOCK_KEY
			STR		R1, [R0] 
			
			;LDR		R0, =GPIO_PORTB_LOCK_R		DEPRONTO EL PUERTO YA ESTA DESBLOQUEADO
			;STR		R1, [R0]
			
			; GPIO_PORTF_CR_R = 0xFF	&	GPIO_PORTB_CR_R = 0xFF
			; Habilita la escritura en los registros del PORTF Y DEL PORT B
			LDR		R0, =GPIO_PORTF_CR_R
			MOV		R1, #0xFF
			STR		R1, [R0] 

			LDR		R0, =GPIO_PORTB_CR_R
			STR		R1, [R0] 
			
			LDR		R0, =GPIO_PORTE_CR_R
			STR		R1, [R0] 
			
			; GPIO_PORTF_AMSEL_R = 0x00	&  GPIO_PORTB_AMSEL_R = 0x00	
			; No activa el modo analogo en PORTF Y EN PORT B
;			LDR		R0, =GPIO_PORTF_AMSEL_R
;			MOV		R1, #0x00
;			STR		R1, [R0] 
;			
;			LDR		R0, =GPIO_PORTB_AMSEL_R
;			STR		R1, [R0] 
;			
;			LDR		R0, =GPIO_PORTE_AMSEL_R
;			STR		R1, [R0]
			
			; GPIO_PORTF_PCTL_R = 0x00000000	&		GPIO_PORTB_PCTL_R = 0x00000000
			; No activa los perifericos en PORTF NI EN PORTB
			LDR		R0, =GPIO_PORTF_PCTL_R
			MOV		R1, #0x00000000
			STR		R1, [R0] 

			LDR		R0, =GPIO_PORTB_PCTL_R
			STR		R1, [R0] 
			
			LDR		R0, =GPIO_PORTE_PCTL_R
			STR		R1, [R0] 
			
			; GPIO_PORTF_DIR_R = 0x00000000		&	GPIO_PORTB_DIR_R = 0x00000000
			; Configura entrada y salidas I/O en PORTF Y EN PORTB
			;  F4 -   F3 - 	 F2 - 	F1 -  F0
			; SW1 - LEDG - LEDB - LEDR - SW2	
			;  	0 -    0 -    0 -    0 -   0 = 0x00
			;  B7 -   B6 -   B5 -   B4 -  B3 - B2 - B1 - B0
			;   1 -    1 -    1 -    1 -   1 -  1 -  1 -  1  =0XFF
			
			; 0 = ENTRADA
			; 1 = SALIDA
			
			LDR		R0, =GPIO_PORTF_DIR_R
			MOV		R1, #0x00
			STR		R1, [R0] 	
			
			LDR		R0, =GPIO_PORTB_DIR_R
			MOV		R1, #0xFF
			STR		R1, [R0] 
			
			LDR		R0, =GPIO_PORTE_DIR_R
			MOV		R1, #0x00
			STR		R1, [R0] 
			
			; GPIO_PORTF_AFSEL_R = 0x00		&		GPIO_PORTB_AFSEL_R = 0x00
			; No configura perifericos en el PORTF NI EN PORTB
			LDR		R0, =GPIO_PORTF_AFSEL_R
			MOV		R1, #0x00
			STR		R1, [R0] 
			
			LDR		R0, =GPIO_PORTB_AFSEL_R
			STR		R1, [R0]
			
			LDR		R0, =GPIO_PORTE_AFSEL_R
			STR		R1, [R0]
		
			; GPIO_PORTF_PUR_R = 0x11
			; Configura pull-up para PF0 y PF4
;			LDR		R0, =GPIO_PORTF_PUR_R
;			MOV		R1, #0x1F
;			STR		R1, [R0] 
			
;			LDR		R0, =GPIO_PORTE_PUR_R
;			MOV		R1, #0xFF
;			STR		R1, [R0]
		
			; GPIO_PORTF_DEN_R = 0x1F		&		GPIO_PORTB_DEN_R = 0x1F
			; Habilita modo digital para PF0 a PF4 y para PB0 a PB7
			LDR		R0, =GPIO_PORTF_DEN_R
			MOV		R1, #0x1F
			STR		R1, [R0] 
			
			LDR		R0, =GPIO_PORTB_DEN_R
			MOV		R1, #0xFF
			STR		R1, [R0] 
			
			LDR		R0, =GPIO_PORTE_DEN_R
			MOV		R1, #0xFF
			STR		R1, [R0] 
				
			LDR		R12, =GPIO_PORTE_DATA_R
			LDR		R11, =GPIO_PORTB_DATA_R
			
INICIO		
			
			LDR		R10, [R12]
			
			CMP		R10, #0x00
			BEQ		NUM0
			CMP		R10, #0x01
			BEQ		NUM1
			CMP		R10, #0x02
			BEQ		NUM2
			CMP		R10, #0x03
			BEQ		NUM3
			CMP		R10, #0x04
			BEQ		NUM4
			CMP		R10, #0x05
			BEQ		NUM5
			CMP		R10, #0x06
			BEQ		NUM6
			CMP		R10, #0x07
			BEQ		NUM7
			CMP		R10, #0x08
			BEQ		NUM8
			CMP		R10, #0x09
			BEQ		NUM9
			CMP		R10, #0x0A
			BEQ		NUM10
			CMP		R10, #0x0B
			BEQ		NUM11
			CMP		R10, #0x0C
			BEQ		NUM12
			CMP		R10, #0x0D
			BEQ		NUM13
			CMP		R10, #0x0E
			BEQ		NUM14
			CMP		R10, #0x0F
			BEQ		NUM15
			
			
			B		INICIO
			
			
NUM0		MOV		R0,	#0xC0
			STR		R0, [R11]
			B		INICIO
			

NUM1		MOV		R0,	#0xF9
			STR		R0, [R11]
			B		INICIO


NUM2			MOV		R0,	#0xA4
			STR		R0, [R11]
			B		INICIO

NUM3		MOV		R0,	#0xB0
			STR		R0, [R11]
			B		INICIO
		
			
NUM4		MOV		R0,	#0x99
			STR		R0, [R11]
			B		INICIO

NUM5		MOV		R0,	#0x92
			STR		R0, [R11]
			B		INICIO
			
NUM6		MOV		R0,	#0x82
			STR		R0, [R11]
			B		INICIO
			
NUM7		MOV		R0,	#0xF8
			STR		R0, [R11]
			B		INICIO

NUM8		MOV		R0,	#0x80
			STR		R0, [R11]
			B		INICIO

NUM9		MOV		R0,	#0x90
			STR		R0, [R11]
			
			B		INICIO

NUM10		MOV		R0,	#0x08		;A
			STR		R0, [R11]
			
			B		INICIO

NUM11		MOV		R0,	#0x03		;B
			STR		R0, [R11]
			
			B		INICIO

NUM12		MOV		R0,	#0x46		;C
			STR		R0, [R11]

			B		INICIO

NUM13		MOV		R0,	#0x21		;D
			STR		R0, [R11]
			
			B		INICIO

NUM14		MOV		R0,	#0x06		;E
			STR		R0, [R11]
			
			B		INICIO

NUM15		MOV		R0,	#0x0E		;F
			STR		R0, [R11]
			
			B		INICIO

			ALIGN                           
			END           